## boards/arm/beagle_bcf/Kconfig.board
```kconfig
# BeagleConnect Freedom board configuration

# Copyright (c) 2020 Erik Larson
# Copyright (c) 2021 Jason Kridner, BeagleBoard.org Foundation
# SPDX-License-Identifier: Apache-2.0

config BOARD_BEAGLECONNECT_FREEDOM
	bool "BeagleConnect Freedom"
	depends on SOC_CC1352P

if BOARD_BEAGLECONNECT_FREEDOM

config BOARD_ANTENNA_INIT_PRIO
	int "Board antenna switch initialization priority"
	default 70
	help
	  Set the priority for board init, must be greater than
	  KERNEL_INIT_PRIORITY_DEVICE but smaller than
	  IEEE802154_CC13XX_CC26XX_SUB_GHZ_INIT_PRIO.

config BOARD_UARTMUX_INIT_PRIO
	int "Board UART mux initialization priority"
	default 99
	help
	  Set the priority for board UART mux switch init

choice BCF_UARTMUX_STATE
	prompt "UART0 MUX State"
	default BCF_UARTMUX_STATE_MSP430

config BCF_UARTMUX_STATE_MSP430
	bool "UART MUX state to enable connection with USB-UART"

config BCF_UARTMUX_STATE_MIKROBUS
	bool "UART MUX state to enable connection with MIKROBUS-UART"

endchoice

endif # BOARD_BEAGLECONNECT_FREEDOM
```

## boards/arm/beagle_bcf/Kconfig.defconfig
```kconfig
# Beagle Connect board

# Copyright (c) 2020 Erik Larson
# SPDX-License-Identifier: Apache-2.0

if BOARD_BEAGLE_CONNECT

config BOARD
	default "beagle_connect"

endif # BOARD_BEAGLE_CONNECT
```

## boards/arm/beagledust/Kconfig.board
```kconfig
# Kconfig - BeagleBoard.org BeagleDust
#
# Copyright (c) 2018 Brett Witherspoon
# Copyright (c) 2019 Jason Kridner
#
# SPDX-License-Identifier: Apache-2.0

config BOARD_BEAGLEDUST
	bool "BeagleBoard.org BeagleDust"
	depends on SOC_CC1352R
```

## boards/arm/beagledust/Kconfig.defconfig
```kconfig
# Kconfig - BeagleBoard.org BeagleDust
#
# Copyright (c) 2018 Brett Witherspoon
# Copyright (c) 2019 Jason Kridner
#
# SPDX-License-Identifier: Apache-2.0

if BOARD_BEAGLEDUST

config BOARD
	default "beagledust"

if SPI

config SPI_0
	default y

endif # SPI

endif # BOARD_BEAGLEDUST
```

## drivers/adc/Kconfig.ads1115
```kconfig
# Copyright (c) 2021 Jackychen
# Copyright (c) 2021 Jason Kridner, BeagleBoard.org Foundation
# SPDX-License-Identifier: Apache-2.0

menuconfig ADC_ADS1115
	bool "ADS1115 adc collector"
	depends on I2C
	help
	  Enable driver for ADS1115 adc collector

if ADC_ADS1115

config ADC_ADS1115_ACQUISITION_THREAD_STACK_SIZE
        int "Stack size for the ADC data acquisition thread"
        default 512
        help
          Size of the stack used for the internal data acquisition
          thread. Increasing size may be required when value function for
          emulated ADC require a lot of memory.

config ADC_ADS1115_ACQUISITION_THREAD_PRIO
        int "Priority for the ADC data acquisition thread"
        default 0
        help
          Priority level for the internal ADC data acquisition thread.

endif # ADC_ADS1115
```

## drivers/gpio/Kconfig.mcux
```kconfig
# MCUX GPIO configuration options

# Copyright (c) 2016 Freescale Semiconductor, Inc.
# Copyright (c) 2017, NXP
# SPDX-License-Identifier: Apache-2.0

config GPIO_MCUX
	bool "MCUX GPIO driver"
	select HAS_DTS_GPIO
	select GPIO_GET_DIRECTION_BITS
	help
	  Enable the MCUX pinmux driver.
```

## drivers/gpio/Kconfig.posix
```kconfig
# Posix GPIO configuration options

# Copyright (c) 2022 BeagleBoard.org Foundation
# SPDX-License-Identifier: Apache-2.0

menuconfig GPIO_POSIX
	bool "Posix GPIO"
	help
	  Enable driver for Native Posix
```

## drivers/gpio/Kconfig.sim
```kconfig
# Simulated GPIO configuration options

# Copyright (c) 2020 Friedt Professional Engineering Services, Inc
# SPDX-License-Identifier: Apache-2.0

config GPIO_SIM
	bool "Simulated GPIO driver"
	default n
	help
	  Enable the simulated GPIO driver. Mainly used for testing, this
	  driver allows for an arbitrary number of simulated GPIO controllers
	  to be instantiated. Furthermore, the simulated pins can be "wired"
	  using using the regular GPIO callback API and the additional API
	  available in drivers/gpio/gpio_sim.h . Configuration for each
	  GPIO instance is accomplished using device tree and an example of
	  such a configuration is in
	  tests/drivers/gpio/gpio_basic_api/boards/native_posix_64.overlay
	  If unsure, say N.
```

## drivers/i2c/Kconfig.sim
```kconfig
# Copyright (c) 2020 Friedt Professional Engineering Services, Inc
# SPDX-License-Identifier: Apache-2.0

config I2C_SIM
	bool "I2C Simulator"
	help
	  Enable support for a simulated I2C bus as well as a limited
	  number of simulated I2C peripherals.
```

## drivers/spi/Kconfig.sim
```kconfig
# Simulated SPI Controller

# Copyright (c) 2020 Friedt Profressional Engineering Services, Inc
# SPDX-License-Identifier: Apache-2.0

config SPI_SIM
	bool "Simulated SPI controller"
	default y
	help
	  Enable support for simulated SPI controllers.
```

## dts/bindings/gpio/zephyr,gpio-emul.yaml
```yaml
# Copyright 2020, Friedt Professional Engineering Services, Inc
# SPDX-License-Identifier: Apache-2.0

description: GPIO Emulator

compatible: "zephyr,gpio-emul"

include: [gpio-controller.yaml, base.yaml]

properties:
    reg:
      required: true

    label:
      required: true

    rising-edge:
      type: boolean

    falling-edge:
      type: boolean

    dual-edge:
      type: boolean

    high-level:
      type: boolean

    low-level:
      type: boolean

    dual-level:
      type: boolean

    "#gpio-cells":
      const: 2

gpio-cells:
  - pin
  - flags
```

## dts/bindings/gpio/zephyr,sim-gpio.yaml
```yaml
# Copyright 2020, Friedt Professional Engineering Services, Inc
# SPDX-License-Identifier: Apache-2.0

description: GPIO Simulator

compatible: "zephyr,sim-gpio"

include: [gpio-controller.yaml, base.yaml]

properties:
    reg:
      required: true

    label:
      required: true

    "#gpio-cells":
      const: 2

gpio-cells:
  - pin
  - flags
```

## dts/bindings/greybus/zephyr,greybus-bundle.yaml
```yaml
# Copyright (c) 2020, Friedt Professional Engineering Services, Inc
# SPDX-License-Identifier: Apache-2.0

# Common fields for Greybus Bundles

description: Greybus Bundle

compatible: "zephyr,greybus-bundle"

include: [base.yaml]

properties:
    "greybus-bundle":
      type: boolean
      required: true
      description: Conveys this node is an instance of a Greybus Bundle
    "#address-cells":
      type: int
      required: false
      default: 1
      const: 1
    "#size-cells":
      type: int
      required: false
      default: 0
      const: 0
```

## dts/bindings/greybus/zephyr,greybus-control.yaml
```yaml
# Copyright (c) 2020, Friedt Professional Engineering Services, Inc
# SPDX-License-Identifier: Apache-2.0

# Common fields for Greybus Controllers

description: Greybus Control

compatible: "zephyr,greybus-control"

include: [base.yaml]

properties:
    "greybus-controller":
      type: boolean
      required: true
      description: Conveys this node is an instance of a Greybus Controller
    "#address-cells":
      type: int
      required: false
      default: 1
      const: 1
    "#size-cells":
      type: int
      required: false
      default: 0
      const: 0
```

## dts/bindings/greybus/zephyr,greybus-gpio-control.yaml
```yaml
# Copyright (c) 2020, Friedt Professional Engineering Services, Inc
# SPDX-License-Identifier: Apache-2.0

# Common fields for Greybus GPIO Controllers

description: Greybus GPIO Controller

compatible: "zephyr,greybus-gpio-controller"

include: [base.yaml]

properties:
    "greybus-gpio-controller":
      type: phandle
      required: true
      description: Conveys which GPIO port is associated with this Greybus GPIO Controller instance
    "#address-cells":
      type: int
      required: false
      default: 1
      const: 1
    "#size-cells":
      type: int
      required: false
      default: 0
      const: 0
```

## dts/bindings/greybus/zephyr,greybus-interface.yaml
```yaml
# Copyright (c) 2020, Friedt Professional Engineering Services, Inc
# SPDX-License-Identifier: Apache-2.0

# Common fields for GPIO controllers

description: Greybus Interface

compatible: "zephyr,greybus-interface"

include: [base.yaml]

properties:
    "greybus-interface":
      type: boolean
      required: true
      description: Conveys this node is an instance of Greybus Platform Data
    "#address-cells":
      type: int
      required: false
      default: 1
      const: 1
    "#size-cells":
      type: int
      required: false
      default: 0
      const: 0
```

## dts/bindings/greybus/zephyr,greybus-string.yaml
```yaml
# Copyright (c) 2020, Friedt Professional Engineering Services, Inc
# SPDX-License-Identifier: Apache-2.0

description: Greybus Manifest String Descriptor

compatible: "zephyr,greybus-string"

include: [base.yaml]

properties:
    "greybus-string":
      type: string
      required: true
      description: Foo
    "#address-cells":
      type: int
      required: false
      default: 1
      const: 1
    "#size-cells":
      type: int
      required: false
      default: 0
      const: 0
```

## dts/bindings/i2c/zephyr,sim-i2c.yaml
```yaml
#
# Copyright (c) 2020 Friedt Professional Engineering Services, Inc
#
# SPDX-License-Identifier: Apache-2.0
#

description: Simulated I2C Controller

compatible: "zephyr,sim-i2c"

include: i2c-controller.yaml

properties:
    reg:
      required: true
```

## dts/bindings/sensor/ti,ads1115.yaml
```yaml
# Copyright (c) 2019, Actinius
# SPDX-License-Identifier: Apache-2.0

description: Texas Instruments ADS1115 analog-to-digital converters

compatible: "ti,ads1115"

include: [adc-controller.yaml, i2c-device.yaml]

properties:
    "#io-channel-cells":
      const: 1

    int_gpios:
      type: phandle-array
      required: false
      description: DRDY/INT pin.

        The DRDY/INT pin of ADS1115 sensor is open-drain, active low. If
        connected directly the MCU pin should be configured as pull-up
        as pull-up, active low.

    continuous_mode:
      type: bool
      required: true
      description: if continuous_mode equal to false, the device is in single mode. true is in continuous_mode.

    oversampling:
      type: int
      required: false
      description: number of samples to grab back-to-back and average

    avg_method:
      type: string
      required: false
      enum:
        - "rms"
        - "mean"
      description: method for averaging oversamples

io-channel-cells:
    - channel
```

## dts/bindings/spi/zephyr,sim-spi.yaml
```yaml
#
# Copyright (c) 2020 Friedt Professional Engineering Services, Inc
#
# SPDX-License-Identifier: Apache-2.0
#

description: Simulated SPI Controller

compatible: "zephyr,sim-spi"

include: spi-controller.yaml

properties:
    reg:
      required: true
```

## subsys/greybus/Kconfig
```kconfig
# Kconfig - Greybus configuration options
#
# Copyright (c) 2019 Christopher Friedt, <chrisfriedt@gmail.com>
#
# SPDX-License-Identifier: Apache-2.0

menuconfig GB
	bool "Greybus"
	help
	  This option enables Greybus support.

if GB

module = GB
module-str = gb
#source "subsys/logging/Kconfig.template.log_config"

config GB_AUDIO
	bool "Greybus Audio"
	default n
	help
	  Select this for Greybus Audio support.

config GB_CAMERA
	bool "Greybus Camera"
	default n
	help
	  Select this for Greybus Camera support.

config GB_GPIO
	bool "Greybus GPIO"
	default n
	help
	  Select this for Greybus GPIO support.

config GB_DEBUG
	bool "Debug Greybus"
	default n
	help
	  Select this to debug Greybus.

config GB_HID
	bool "Greybus HID"
	default n
	help
	  Select this for Greybus HID support.

config GB_I2C
	bool "Greybus I2C support"
	default n
	help
	  Select this for Greybus I2C support.

config GB_LIGHTS
	bool "Greybus Lights"
	default n
	help
	  Select this for Greybus Light support.

config GB_LOOPBACK
	bool "Greybus Loopback"
	default n
	help
	  Select this for Greybus Loopback support.

config GB_POWER_SUPPLY
	bool "Greybus Power Supply"
	default n
	help
	  Select this for Greybus Power Supply support.

config GB_PWM
	bool "Greybus PWM"
	default n
	help
	  Select this for Greybus Pulse Width Modulation support.

config GB_SDIO
	bool "Greybus SDIO"
	default n
	help
	  Select this for Greybus Secure Digital IO support.

config GB_SPI
	bool "Greybus SPI"
	default n
	help
	  Select this for Greybus Serial Peripheral Interface support.

config GB_UART
	bool "Greybus UART"
	default n
	help
	  Select this for Greybus Universal Asynchronous Receiver Transmitter support.

config GB_USB
	bool "Greybus USB"
	default n
	help
	  Select this for Greybus Universal Serial Bus support.

config GB_VIBRATOR
	bool "Greybus Vibrator"
	default n
	help
	  Select this for Greybus Vibrator support.

endif # GB
```

## tests/drivers/spi/spi_eeprom/testcase.yaml
```yaml
tests:
  drivers.spi:
    depends_on: spi eeprom
    tags: drivers spi eeprom
    harness: loopback
```

## tests/subsys/greybus/i2c/testcase.yaml
```yaml
tests:
  subsys.greybus:
    tags: greybus
    depends_on: greybus i2c
    min_flash: 34
    filter: dt_compat_enabled("test,greybus")
    harness: ztest
```

## west.yml
```yaml
# The west manifest file for upstream Zephyr.
#
# The per-installation west configuration file, .west/config, sets the
# path to the project containing this file in the [manifest] section's
# "path" variable.
#
# You are free to create your own manifest files and put them in any
# repository you want, to create your own custom Zephyr installations.
# For example, you could create a manifest file in your own out of
# tree application directory, which would pull this zephyr repository
# in as an ordinary project.
#
# You can pass your manifest repositories to west init when creating a
# new Zephyr installation. See the west documentation for more
# information.

manifest:
  defaults:
    remote: upstream

  remotes:
    - name: upstream
      url-base: https://github.com/zephyrproject-rtos
    - name: bcf-sdk
      url-base: https://github.com/jadonk

  #
  # Please add items below based on alphabetical order
  projects:
    - name: cmsis
      revision: 5f86244bad4ad5a590e084f0e72ba7a1416c2edf
      path: modules/hal/cmsis
      groups:
        - hal
    - name: hal_ti
      revision: c54f72e1a6be33733c684dcbbb47c84e8e332d68
      path: modules/hal/ti
      groups:
        - hal
    - name: mbedtls
      revision: 7fed49c9b9f983ad6416986661ef637459723bcb
      path: modules/crypto/mbedtls
      groups:
        - crypto
    - name: mcuboot
      revision: e7415b555134e671ba04f036b02f55cbc087d0e9
      path: bootloader/mcuboot
    - name: net-tools
      revision: f49bd1354616fae4093bf36e5eaee43c51a55127
      path: tools/net-tools
      groups:
        - tools
    - name: wpanusb_bc
      remote: bcf-sdk
      path: modules/lib/wpanusb_bc
      revision: main
    - name: greybus-for-zephyr
      remote: bcf-sdk
      path: modules/lib/greybus
      revision: mikrobus-2.7-hacks
    - name: manifesto
      remote: bcf-sdk
      path: modules/lib/greybus/scripts/manifesto
      revision: main

  group-filter:
    - -ci

  self:
    path: zephyr
    west-commands: scripts/west-commands.yml
    import: submanifests
```
