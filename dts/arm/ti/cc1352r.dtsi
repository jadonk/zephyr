/*
 * Copyright (c) 2019 Brett Witherspoon
 *
 * SPDX-License-Identifier: Apache-2.0
 */

#include <mem.h>
#include <ti/cc13x2_cc26x2.dtsi>

/ {
	sram0: memory@20000000 {
		reg = <0x20000000 DT_SIZE_K(80)>;
	};

	flash0: flash-controller@400fd000 {
		compatible = "ti,stellaris-flash-controller";
		reg = <0x400fd000 0x1000>;
		#address-cells = <1>;
		#size-cells = <1>;
		label = "FLASH_CTRL";
		serial-flash@0 {
			reg = <0x0 DT_SIZE_K(352)>;
		};
	};
};
