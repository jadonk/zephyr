## CMakeLists.txt
```
# SPDX-License-Identifier: Apache-2.0

cmake_minimum_required(VERSION 3.13.1)
include($ENV{ZEPHYR_BASE}/cmake/app/boilerplate.cmake NO_POLICY_SCOPE)
project(greybus-uart)

target_sources(app PRIVATE src/main.c)
```

## prj.conf
```kconfig
CONFIG_NEWLIB_LIBC=y
CONFIG_LOG=y
CONFIG_GREYBUS=y
CONFIG_GPIO=y
#CONFIG_I2C=y
#CONFIG_SPI=y
#CONFIG_GREYBUS_AUDIO=y
#CONFIG_GREYBUS_CAMERA=y
CONFIG_GREYBUS_CONTROL=y
CONFIG_GREYBUS_GPIO=y
#CONFIG_GREYBUS_HID=y
#CONFIG_GREYBUS_I2C=y
#CONFIG_GREYBUS_LIGHTS=y
#CONFIG_GREYBUS_LOOPBACK=y
#CONFIG_GREYBUS_POWER_SUPPLY=y
#CONFIG_GREYBUS_PWM=y
#CONFIG_GREYBUS_SDIO=y
#CONFIG_GREYBUS_SPI=y
#CONFIG_GREYBUS_UART=y
#CONFIG_GREYBUS_USB=y
#CONFIG_GREYBUS_VIBRATOR=y
CONFIG_CONSOLE_SUBSYS=y
CONFIG_CONSOLE_GETCHAR=y

CONFIG_GREYBUS_XPORT_UART=y

# Temporary until automatic thread stack allocation is available
CONFIG_MAX_PTHREAD_COUNT=16
CONFIG_PTHREAD_DYNAMIC_STACK=y
CONFIG_PTHREAD_DYNAMIC_STACK_SIZE=1048
CONFIG_PTHREAD_DYNAMIC_STACK_RESERVED_COUNT=16

CONFIG_SHELL=y
CONFIG_INIT_STACKS=y

CONFIG_GREYBUS_XPORT_UART_DEV="UART_0"
```

## src/main.c
```c
/*
 * Copyright (c) 2109 Friedt Professional Engineering Services, Inc
 *
 * SPDX-License-Identifier: Apache-2.0
 */

#define DEBUG

#include <errno.h>
#include <stdbool.h>
#include <stdint.h>
#include <stdio.h>
#include <string.h>
#include <zephyr.h>

extern int greybus_service_init(struct device *bus);

int main(int argc, char *argv[])
{
	int r = greybus_service_init(NULL);
	if (r < 0) {
		printf("gb_service_deferred_init() failed: %d\n", r);
		return r;
	}

	for(;;) {
		k_usleep(1000000);
	}

	return 0;
}
```
