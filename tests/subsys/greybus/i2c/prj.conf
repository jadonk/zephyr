## prj.conf
```kconfig
CONFIG_ZTEST=y

#CONFIG_REQUIRES_FULL_LIBC=y
#CONFIG_NEWLIB_LIBC=y
#CONFIG_GPIO=y
CONFIG_I2C=y
CONFIG_GREYBUS=y
#CONFIG_GB_LOG_LEVEL=4
#CONFIG_GREYBUS_AUDIO=y
#CONFIG_GREYBUS_CAMERA=y
CONFIG_GREYBUS_CONTROL=y
#CONFIG_GREYBUS_GPIO=y
#CONFIG_GREYBUS_DEBUG=y
#CONFIG_GREYBUS_HID=y
CONFIG_GREYBUS_I2C=y
#CONFIG_GREYBUS_LIGHTS=y
#CONFIG_GREYBUS_LOOPBACK=y
#CONFIG_GREYBUS_POWER_SUPPLY=y
#CONFIG_GREYBUS_PWM=y
#CONFIG_GREYBUS_SDIO=y
#CONFIG_GREYBUS_SPI=y
#CONFIG_GREYBUS_UART=y
#CONFIG_GREYBUS_USB=y
#CONFIG_GREYBUS_VIBRATOR=y
CONFIG_CONSOLE_SUBSYS=y
#CONFIG_CONSOLE_GETCHAR=y
CONFIG_NO_OPTIMIZATIONS=y
CONFIG_MINIMAL_LIBC_MALLOC_ARENA_SIZE=16384
#CONFIG_MINIMAL_LIBC_MALLOC_ARENA_SIZE=32768
# Generic networking options
CONFIG_NETWORKING=y
CONFIG_NET_UDP=y
CONFIG_NET_TCP=y
CONFIG_NET_IPV6=y
CONFIG_NET_IPV4=y
CONFIG_NET_SOCKETS=y
CONFIG_NET_SOCKETS_POSIX_NAMES=y
CONFIG_POSIX_MAX_FDS=32

# Kernel options
CONFIG_MAIN_STACK_SIZE=1024
#CONFIG_ENTROPY_GENERATOR=y
CONFIG_TEST_RANDOM_GENERATOR=y
CONFIG_INIT_STACKS=y

# Logging
CONFIG_NET_LOG=y
CONFIG_LOG=y
CONFIG_NET_STATISTICS=y
CONFIG_PRINTK=y

# Network buffers
CONFIG_NET_PKT_RX_COUNT=4
CONFIG_NET_PKT_TX_COUNT=4
CONFIG_NET_BUF_RX_COUNT=16
CONFIG_NET_BUF_TX_COUNT=16
CONFIG_NET_CONTEXT_NET_PKT_POOL=y

# IP address options
CONFIG_NET_IF_UNICAST_IPV6_ADDR_COUNT=3
CONFIG_NET_IF_MCAST_IPV6_ADDR_COUNT=4
CONFIG_NET_MAX_CONTEXTS=10

# Network shell
CONFIG_NET_SHELL=y
CONFIG_SHELL=y

# Network application options and configuration
CONFIG_NET_CONFIG_SETTINGS=y
CONFIG_NET_CONFIG_MY_IPV6_ADDR="2001:db8::1"
CONFIG_NET_CONFIG_PEER_IPV6_ADDR="2001:db8::2"
CONFIG_NET_CONFIG_MY_IPV4_ADDR="192.0.2.1"
CONFIG_NET_CONFIG_PEER_IPV4_ADDR="192.0.2.2"

# How many client can connect to echo-server simultaneously
#CONFIG_NET_SAMPLE_NUM_HANDLERS=1

# Temporary until automatic thread stack allocation is available
CONFIG_PTHREAD_DYNAMIC_STACK=y
CONFIG_PTHREAD_DYNAMIC_STACK_RESERVED_COUNT=8
```

## boards/native_posix_64.conf
```kconfig
CONFIG_I2C_SIM=y
CONFIG_I2C_0=y
```

## src/main.c
```c
/*
 * Copyright (c) 2020 Friedt Professional Engineering Services, Inc
 *
 * SPDX-License-Identifier: Apache-2.0
 */

#include <ztest.h>

extern void test_greybus_i2c_protocol_version(void);
extern void test_greybus_i2c_cport_shutdown(void);
extern void test_greybus_i2c_functionality(void);
extern void test_greybus_i2c_transfer(void);

static void board_setup(void)
{
}

extern void test_greybus_setup(void);
extern void test_greybus_teardown(void);

void test_main(void) {

	board_setup();
	test_greybus_setup();
    ztest_test_suite(greybus_i2c,
        ztest_unit_test(test_greybus_i2c_protocol_version),
        ztest_unit_test(test_greybus_i2c_cport_shutdown),
        ztest_unit_test(test_greybus_i2c_functionality),
        ztest_unit_test(test_greybus_i2c_transfer)
        );
    ztest_run_test_suite(greybus_i2c);
    test_greybus_teardown();
}
```

## src/i2c-sim.c
```c
/*
 * Copyright (c) 2020 Friedt Professional Engineering Services, Inc
 *
 * SPDX-License-Identifier: Apache-2.0
 */

#ifdef CONFIG_I2C_SIM

#include <drivers/i2c.h>
#include <drivers/i2c/i2c_sim.h>
#include <drivers/sensor.h>
#include <stdio.h>
#include <zephyr.h>

#include <logging/log.h>
LOG_MODULE_REGISTER(test_i2c_sim, CONFIG_I2C_LOG_LEVEL);

#include "test-greybus-i2c.h"
#include "../../../drivers/sensor/hmc5883l/hmc5883l.h"

enum {
    HMC5883L_REG_CFG_A = HMC5883L_REG_CONFIG_A,
    HMC5883L_REG_CFG_B,
    HMC5883L_REG_MODE_ = HMC5883L_REG_MODE,
    HMC5883L_REG_X_MSB = HMC5883L_REG_DATA_START,
    HMC5883L_REG_X_LSB,
    HMC5883L_REG_Z_MSB,
    HMC5883L_REG_Z_LSB,
    HMC5883L_REG_Y_MSB,
    HMC5883L_REG_Y_LSB,
    HMC5883L_REG_STATUS,
    HMC5883L_REG_ID_A = HMC5883L_REG_CHIP_ID,
    HMC5883L_REG_ID_B,
    HMC5883L_REG_ID_C,
    HMC5883L_REG_NUM,
    HMC5883L_REG_PTR = HMC5883L_REG_NUM,
};

#define HMC5883L_REG_INIT { \
    [HMC5883L_REG_CHIP_ID + 0] = HMC5883L_CHIP_ID_A, \
    [HMC5883L_REG_CHIP_ID + 1] = HMC5883L_CHIP_ID_B, \
    [HMC5883L_REG_CHIP_ID + 2] = HMC5883L_CHIP_ID_C, \
}

static uint8_t hmc5883l_reg[HMC5883L_REG_NUM + 1] = HMC5883L_REG_INIT;

static char *to_string(uint8_t *data, size_t len)
{
    static char buf[64];
    char *p = buf;

    memset(buf, '\0', sizeof(buf));
    for(size_t i = 0; i < len && p < buf + sizeof(buf) - 4; ++i) {
        sprintf(p, "%02x", data[i]);
        p += 2;
        if (i < len - 1) {
            *p++ = ',';
            *p++ = ' ';
        }
    }

    return buf;
}

static int i2c_sim_hmc_callback(struct device *dev,
				 struct i2c_msg *msgs,
				 uint8_t num_msgs,
				 uint16_t addr)
{
    ARG_UNUSED(dev);
    uint8_t j;
    uint8_t ptr;
    uint8_t len;

    for(uint8_t i = 0; i < num_msgs; ++i) {

        ptr = hmc5883l_reg[HMC5883L_REG_PTR];
        //LOG_DBG("%s(): ptr: %u", __func__, ptr);

        char *dump = log_strdup(to_string(msgs[i].buf, msgs[i].len)); 
        LOG_DBG("%s(): %c: addr: %04x: flags: %02x len: %u buf: [%s]",
            __func__, (msgs[i].flags & I2C_MSG_READ) ? 'R': 'W',
            addr, msgs[i].flags, msgs[i].len,
            dump
        );

        switch(msgs[i].len) {
        case 0:
            __ASSERT(msgs[i].len > 0, "unsupported operation length");
            break;
        case 1:
            ptr = msgs[i].buf[0];
            break;
        default:
            len = msgs[i].len;
            if (msgs[i].flags & I2C_MSG_READ) {
                for(j = 0; ptr < HMC5883L_REG_NUM && len > 0; ++ptr, --len, ++j) {
                    msgs[i].buf[j] = hmc5883l_reg[ptr];
                }
            } else {
                __ASSERT((len % 2) == 0, "msgs[%u].len (%u) is not a multiple of two", i, msgs[i].len);
                for(j = 0; len > 0; len -= 2, j += 2) {
                    ptr = msgs[i].buf[j];
                    ptr %= HMC5883L_REG_NUM;
                    if (0 <= ptr && ptr <= 2) {
                        hmc5883l_reg[ptr] = msgs[i].buf[j + 1];
                    }
                }
            }
            break;
        }
        //LOG_DBG("%s(): ptr: %u", __func__, ptr);
        hmc5883l_reg[HMC5883L_REG_PTR] = ptr;
    }

    return 0;
}

void i2c_sim_setup(void)
{
    int r;
    struct device *dev;

    dev = device_get_binding(I2C_DEV_NAME);
    __ASSERT(dev != NULL, "failed to get binding for " I2C_DEV_NAME);

    r = i2c_sim_callback_register(dev, 0x1e, i2c_sim_hmc_callback);
    __ASSERT(r == 0, "failed to register i2c_sim callback: %d", r);
}

#endif /* CONFIG_I2C_SIM */
```

## src/i2c.c
```c
/*
 * Copyright (c) 2020 Friedt Professional Engineering Services, Inc
 *
 * SPDX-License-Identifier: Apache-2.0
 */

#include <device.h>
#include <errno.h>
#include <greybus/greybus.h>
#include <string.h>
#include <sys/util.h>
#include <ztest.h>
#include <zephyr.h>

#if defined(CONFIG_BOARD_NATIVE_POSIX_64BIT) ||                                \
	defined(CONFIG_BOARD_NATIVE_POSIX_32BIT) ||                            \
	defined(CONFIG_BOARD_NRF52_BSIM)

#include <arpa/inet.h>
#include <netinet/in.h>
#include <poll.h>
#include <sys/byteorder.h>
#include <sys/types.h>
#include <sys/socket.h>
#include <unistd.h>

#else

#include <net/socket.h>
#include <posix/unistd.h>

#endif

#include "../../../../subsys/greybus/i2c-gb.h"

#include "test-greybus-i2c.h"

#define TIMEOUT_MS (-1)
#define PORT 4243

static struct device *i2c_dev;

static int fd = -1;

static char *to_string(uint8_t *data, size_t len)
{
    static char buf[256];
    char *p = buf;

    memset(buf, '\0', sizeof(buf));
    for(size_t i = 0; i < len && p < buf + sizeof(buf) - 4; ++i) {
        sprintf(p, "%02x", data[i]);
        p += 2;
        if (i < len - 1) {
            *p++ = ',';
            *p++ = ' ';
        }
    }

    return buf;
}

void test_greybus_setup(void)
{
	struct sockaddr_in6 addr = {
		.sin6_family = AF_INET6,
		.sin6_addr = in6addr_loopback,
		.sin6_port = htons(PORT),
	};
	socklen_t addrlen = sizeof(addr);
	int r;

	i2c_dev = device_get_binding(I2C_DEV_NAME);
	zassert_not_equal(i2c_dev, NULL,
			  "failed to get device binding for " I2C_DEV_NAME);

	r = socket(AF_INET6, SOCK_STREAM, 0);
	__ASSERT(r >= 0, "connect: %d", errno);
	fd = r;

	r = connect(fd, (const struct sockaddr *)&addr, addrlen);
	__ASSERT(r == 0, "connect: %d", errno);
}

void test_greybus_teardown(void)
{
	if (fd != -1) {
		close(fd);
		fd = -1;
	}
}

static void tx_rx(const struct gb_operation_hdr *req,
		  struct gb_operation_hdr *rsp, size_t rsp_size)
{
	int r;
	int size;
	struct pollfd pollfd;

	size = sys_le16_to_cpu(req->size);
	r = send(fd, req, size, 0);
	zassert_not_equal(r, -1, "send: %s", errno);
	zassert_equal(r, size, "send: expected: %d actual: %d", size, r);

	pollfd.fd = fd;
	pollfd.events = POLLIN;

	r = poll(&pollfd, 1, TIMEOUT_MS);
	zassert_not_equal(r, -1, "poll: %s", errno);
	zassert_not_equal(r, 0, "timeout waiting for response");
	zassert_equal(r, 1, "invalid number of pollfds with data: %d", r);

	r = recv(fd, rsp, rsp_size, 0);
	zassert_not_equal(r, -1, "recv: %s", errno);
	if (r != rsp_size) {
		printk("rsp: [%s]", to_string((uint8_t *)rsp, r));
	}
	zassert_equal(rsp_size, r, "recv: expected: %u actual: %u",
		      (unsigned)rsp_size, r);

	zassert_equal(rsp->id, req->id,
			  "expected: 0x%04x actual: 0x%04x",
			  sys_le16_to_cpu(req->id),
			  sys_le16_to_cpu(rsp->id));
	zassert_equal(rsp->type, GB_TYPE_RESPONSE_FLAG | req->type,
			  "expected: %u actual: %u",
			  GB_TYPE_RESPONSE_FLAG | req->type, rsp->type);
}

void test_greybus_i2c_protocol_version(void)
{
	const struct gb_operation_hdr req = {
		.size = sys_cpu_to_le16(sizeof(struct gb_operation_hdr)),
		.id = sys_cpu_to_le16(0xabcd),
		.type = GB_I2C_PROTOCOL_VERSION,
	};
	uint8_t rsp_[0 + sizeof(struct gb_operation_hdr) +
		     sizeof(struct gb_i2c_proto_version_response)];
	const size_t rsp_size = sizeof(rsp_);
	struct gb_operation_hdr *const rsp =
		(struct gb_operation_hdr *)rsp_;
	struct gb_i2c_proto_version_response *const pv_rsp =
		(struct gb_i2c_proto_version_response
			 *)(rsp_ + sizeof(struct gb_operation_hdr));

	/* add some "noise" values that should be overwritten */
	pv_rsp->major = 0xf0;
	pv_rsp->minor = 0x0d;

	tx_rx(&req, rsp, rsp_size);

	zassert_equal(rsp->result, GB_OP_SUCCESS,
		      "expected: GB_OP_SUCCESS actual: %u",
		      rsp->result);

	/* GB_I2C_VERSION_MAJOR (0) is buried in subsys/greybus/i2c.c */
	zassert_equal(pv_rsp->major, 0, "expected: %u actual: %u", 0, pv_rsp->major);

	/* GB_I2C_VERSION_MINOR (1) is buried in subsys/greybus/i2c.c */
	zassert_equal(pv_rsp->minor, 1, "expected: %u actual: %u", 1, pv_rsp->minor);
}

void test_greybus_i2c_cport_shutdown(void)
{
	/*
	 * looks like the original NuttX implementation was missing any kind
	 * of cport shutdown request
	 */
}

void test_greybus_i2c_functionality(void)
{
	const struct gb_operation_hdr req = {
		.size = sys_cpu_to_le16(sizeof(struct gb_operation_hdr)),
		.id = sys_cpu_to_le16(0xabcd),
		.type = GB_I2C_PROTOCOL_FUNCTIONALITY,
	};
	uint8_t rsp_[0 + sizeof(struct gb_operation_hdr) +
		     sizeof(struct gb_i2c_functionality_rsp)];
	const size_t rsp_size = sizeof(rsp_);
	struct gb_i2c_functionality_rsp *const rsp =
		(struct gb_i2c_functionality_rsp
			 *)(rsp_ + sizeof(struct gb_operation_hdr));
	uint32_t expected_uint32;
	uint32_t actual_uint32;

	tx_rx(&req, (struct gb_operation_hdr *)rsp_, rsp_size);

	zassert_equal(((struct gb_operation_hdr *)rsp_)->result, GB_OP_SUCCESS,
		      "expected: GB_OP_SUCCESS actual: %u",
		      ((struct gb_operation_hdr *)rsp_)->result);

	expected_uint32 = GB_I2C_FUNC_I2C | GB_I2C_FUNC_SMBUS_READ_BYTE |
			  GB_I2C_FUNC_SMBUS_WRITE_BYTE |
			  GB_I2C_FUNC_SMBUS_READ_BYTE_DATA |
			  GB_I2C_FUNC_SMBUS_WRITE_BYTE_DATA |
			  GB_I2C_FUNC_SMBUS_READ_WORD_DATA |
			  GB_I2C_FUNC_SMBUS_WRITE_WORD_DATA |
			  GB_I2C_FUNC_SMBUS_READ_I2C_BLOCK |
			  GB_I2C_FUNC_SMBUS_WRITE_I2C_BLOCK;

	actual_uint32 = sys_le32_to_cpu(rsp->functionality);

	zassert_equal(expected_uint32, actual_uint32,
		      "functionality: expected: %08x actual: %08x",
		      expected_uint32, actual_uint32);
}

void test_greybus_i2c_transfer(void)
{
	/* this test simulates some operations on an hmc5883l 3-axis accelerometer */

	/*
	 * D: i2c_sim_hmc_callback(): W: addr: 001e: flags: 02 len: 2 buf: [01, 20]
	 * D: i2c_sim_hmc_callback(): W: addr: 001e: flags: 02 len: 2 buf: [02, 00]
	 * D: i2c_sim_hmc_callback(): W: addr: 001e: flags: 02 len: 1 buf: [03]
	 * D: i2c_sim_hmc_callback(): R: addr: 001e: flags: 03 len: 6 buf: [00, 00, 00, 00, 00, 00]
	 */ 

#define DESC(_addr, _flags, _size) \
	{ \
		.addr = sys_cpu_to_le16(_addr), \
		.flags =  sys_cpu_to_le16(_flags), \
		.size =  sys_cpu_to_le16(_size), \
	}

	const uint8_t write_data[] = {
		0x01, 0x20,
		0x02, 0x00,
		0x03,
	};

	const struct gb_i2c_transfer_desc descs[] = {
		DESC(0x1e, 0, 2),
		DESC(0x1e, 0, 2),
		DESC(0x1e, 0, 1),
		DESC(0x1e, GB_I2C_M_RD, 6),	
	};

	uint8_t req_[
		0
		+ sizeof(struct gb_operation_hdr)
		+ sizeof(struct gb_i2c_transfer_req)
		+ ARRAY_SIZE(descs) * sizeof(struct gb_i2c_transfer_desc)
		/* Would be nice if constexpr existed in C ... oh well */
		+ (2 + 2 + 1 /* request size only counts write ops */)
		] = {};
	const size_t req_size = sizeof(req_);

	struct gb_operation_hdr *const req =
		(struct gb_operation_hdr *)req_;
	
	req->size = sys_cpu_to_le16(req_size);
	req->id = sys_cpu_to_le16(0xabcd);
	req->type = GB_I2C_PROTOCOL_TRANSFER;

	struct gb_i2c_transfer_req *const xfer_req =
		(struct gb_i2c_transfer_req *)
		(req_ + sizeof(*req));
	xfer_req->op_count = sys_cpu_to_le16(ARRAY_SIZE(descs));

	uint8_t rsp_[
		0
		+ sizeof(struct gb_operation_hdr)
		/* Would be nice if constexpr existed in C ... oh well */
		+ (6 /* response size only counts read ops */)
		];
	const size_t rsp_size = sizeof(rsp_);
	struct gb_operation_hdr *const rsp =
		(struct gb_operation_hdr *)rsp_;

	struct gb_i2c_transfer_rsp *const xfer_rsp =
		(struct gb_i2c_transfer_rsp *)
		(rsp_ + sizeof(struct gb_operation_hdr));

	/* the assertion is that the rsp is *not* equal to this */
	const uint8_t expected_data[] = {
		0x01, 0x23, 0x45, 0x67, 0x89, 0xab,
	};
	uint8_t *const actual_data = xfer_rsp->data;

	memcpy(xfer_rsp->data, expected_data, sizeof(expected_data));

	uint8_t *payload = (uint8_t *)xfer_req->desc;
	memcpy(payload, descs, sizeof(descs));
	payload += sizeof(descs);
	memcpy(payload, write_data, sizeof(write_data)); 

	tx_rx(req, rsp, rsp_size);

	zassert_equal(((struct gb_operation_hdr *)rsp_)->result, GB_OP_SUCCESS,
		      "expected: GB_OP_SUCCESS actual: %u",
		      ((struct gb_operation_hdr *)rsp_)->result);

	zassert_not_equal(0, memcmp(expected_data, actual_data, sizeof(expected_data)),
		"expected response to generate %u bytes ofdata", sizeof(expected_data));
}
```

## src/test-greybus-i2c.h
```c
/*
 * Copyright (c) 2016 Intel Corporation
 *
 * SPDX-License-Identifier: Apache-2.0
 */

#ifndef __TEST_I2C_H__
#define __TEST_I2C_H__

#include <devicetree.h>

#if DT_NODE_HAS_STATUS(DT_ALIAS(i2c_0), okay)
#define I2C_DEV_NAME	DT_LABEL(DT_ALIAS(i2c_0))
#elif DT_NODE_HAS_STATUS(DT_ALIAS(i2c_1), okay)
#define I2C_DEV_NAME	DT_LABEL(DT_ALIAS(i2c_1))
#elif DT_NODE_HAS_STATUS(DT_ALIAS(i2c_2), okay)
#define I2C_DEV_NAME	DT_LABEL(DT_ALIAS(i2c_2))
#else
#error "Please set the correct I2C device"
#endif

#endif /* __TEST_I2C_H__ */
```
